#include <SPI.h>
#include <Wire.h>
#include <HTTPClient.h>
// #include <Adafruit_GFX.h>
// #include <Adafruit_SH1106.h>

// #define OLED_SDA 12
// #define OLED_SCL 14

// Adafruit_SH1106 display(12, 14);

// #include "Adafruit_SHT4x.h"
// #include "Adafruit_SGP40.h"
#include <WiFi.h>
// #include "ThingSpeak.h"

// #define WIFI_NETWORK "JioFi3_259D0E"
// #define WIFI_PASSWORD "k61m12m0u5"

// // Suresh 1
// unsigned long myChannelNumber = 1836849;
// const char * myWriteAPIKey = "WLO71LC45VQ77FGU";

//// Murali 2
// unsigned long myChannelNumber = 1843906;
// const char * myWriteAPIKey = "1SK357NZ84IDRES0";

//
//////Kiran 3
// unsigned long myChannelNumber = 1843903;
// const char * myWriteAPIKey = "EY0KSJFWLW7PDK3C";
//
////Vamshi
// unsigned long myChannelNumber = 1788132;
// const char * myWriteAPIKey = "WJ5QH39TFBNMAMFW";

// unsigned int voc_index_G;
// unsigned long duration, th, tl;
//   int ppm;
// float Temp_VOC;
// float HUM_VOC;

char *ssid = ":heisrightyouknow:";
char *pass = "ESW_PASS1234";

String cse_ip = "192.168.164.219";
String cse_port = "8080";

String server = "http://" + cse_ip + ":" + cse_port + "/~/in-cse/in-name/";
String ae = "Sensor_Readings";
String cnt[] = {"Prana_PM2.5", "Prana_PM10", "CO2_Levels", "VOC_Levels", "Temperature", "Humidity"};
int pm2, pm10;
//
void CreateCIPM2_5()
{
    HTTPClient http;
    http.begin(server + ae + "/" + cnt[0] + "/");
    // Serial.println(server + ae + "/" + cnt[0] + "/");
    http.addHeader("X-M2M-Origin", "admin:admin");
    http.addHeader("Content-Type", "application/json;ty=4");
    String body = "{\"m2m:cin\": {\"cnf\": \"application/json\",\"con\": " + String(pm2) + "}}";
    Serial.println(body);

    int response = http.POST(body);
    Serial.println(response);
    if (response == -1)
    {
        Serial.println("Unable to connect");
    }
    http.end();
}

void CreateCIPM10()
{
    HTTPClient http;
    http.begin(server + ae + "/" + cnt[1] + "/");
    // Serial.println(server + ae + "/" + cnt[0] + "/");
    http.addHeader("X-M2M-Origin", "admin:admin");
    http.addHeader("Content-Type", "application/json;ty=4");
    String body = "{\"m2m:cin\": {\"cnf\": \"application/json\",\"con\": " + String(pm10) + "}}";
    Serial.println(body);

    int response = http.POST(body);
    Serial.println(response);
    if (response == -1)
    {
        Serial.println("Unable to connect");
    }
    http.end();
}

const unsigned char iiith[] PROGMEM = {
    0x00, 0x00, 0x00, 0x00, 0x00, 0x00, 0x00, 0x00, 0x00, 0x00, 0x00, 0x00, 0x00, 0x00, 0x00, 0x00,
    0x00, 0x00, 0x00, 0x00, 0x00, 0x00, 0x00, 0x00, 0x00, 0x00, 0x00, 0x00, 0x00, 0x00, 0x00, 0x00,
    0x00, 0x00, 0x00, 0x00, 0x00, 0x00, 0x00, 0x00, 0x20, 0x00, 0x00, 0x00, 0x00, 0x00, 0x00, 0x00,
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    0x00, 0x00, 0x00, 0x00, 0x00, 0x00, 0x00, 0x00, 0x00, 0x00, 0x00, 0x00, 0x00, 0x00, 0x00, 0x00};
const unsigned char temp[] PROGMEM = {
    0xff, 0xff, 0xff, 0xff, 0xff, 0xff, 0xff, 0xff, 0x80, 0x00, 0x00, 0x00, 0x00, 0x00, 0x00, 0x01,
    0x80, 0x00, 0x00, 0x00, 0x00, 0x00, 0x00, 0x01, 0x80, 0x00, 0x00, 0x00, 0x00, 0x00, 0x00, 0x01,
    0x80, 0x00, 0x00, 0x00, 0x00, 0x00, 0x00, 0x01, 0x80, 0x00, 0x00, 0x00, 0x00, 0x00, 0x00, 0x01,
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    0x80, 0x00, 0x00, 0x00, 0x00, 0x00, 0x00, 0x01, 0xff, 0xff, 0xff, 0xff, 0xff, 0xff, 0xff, 0xff};

void ConnectToWifi()
{
    Serial.println("Connecting To wifi!!");
    WiFi.mode(WIFI_STA);
    WiFi.begin(ssid, pass);
    while (WiFi.status() != WL_CONNECTED)
    {
        WiFi.begin(ssid, pass);
        Serial.print(".");
        delay(3000);
    }
    Serial.println("Connected to Wifi");
    Serial.println(WiFi.localIP());
}

WiFiClient client;

// //------------------------------------------------CO2 Sensing-----------------------------------------------------
// #define PIN 18

// void CO2_Monitor() {

//   th = pulseIn(PIN, HIGH, 2008000) / 1000;
//   tl = 1004 - th;
//   ppm = 2000 * (th - 2) / (th + tl - 4);

//   if (ppm > 1000) {
//     Serial.println(ppm);
    // ThingSpeak.setField(1, ppm);
//   }
//   else {
//     Serial.print(" Co2 Concentration: ");
//     Serial.println(ppm);
//     ThingSpeak.setField(1, ppm);
//     //    Serial.println(" ppm");
//   }
// }

// //--------------------------------------------------SHT4x---------------------------------------------------------------------------------------------------------------------------------------
// Adafruit_SHT4x sht4 = Adafruit_SHT4x();
// Adafruit_SGP40 sgp;
// void SHT_setup() {
//   sht4.begin();
//   sgp.begin();

// }

// void SHT_Reading() {

//   sensors_event_t humidity, temp;
//   sht4.getEvent(&humidity, &temp);// populate temp and humidity objects with fresh data

//     Temp_VOC = temp.temperature;
//     HUM_VOC = humidity.relative_humidity;

//   Serial.print("Temperature: ");
//   Serial.println(Temp_VOC);
//   //  Serial.println(" degrees C");

//   Serial.print("Humidity: ");
//   Serial.println(HUM_VOC);
//   //  Serial.println("% rH");

//   ThingSpeak.setField(5, Temp_VOC);
//   ThingSpeak.setField(6, HUM_VOC);
//   int raw;
//   raw = sgp.measureRaw(Temp_VOC, HUM_VOC);
//   Serial.print("VOC: ");
//   Serial.println(raw);
//   ThingSpeak.setField(2, raw);
//   voc_index_G = sgp.measureVocIndex(Temp_VOC, HUM_VOC);
//   Serial.print("Voc Index: ");
//   Serial.println(voc_index_G);
//   delay(500);
// }

// //-------------------------------------------------SGP-------------------------------------------------------------------------------------------------------------------------------------------
// //Adafruit_SGP40 sgp;
// //
// //void SGP_setup() {
// //  Serial.println("SGP40 test");
// //
// //  if (! sgp.begin()) {
// //    Serial.println("Sensor not found :(");
// //  }
// //}
// //
// //void SGP_Reading() {
// //
// //  int raw;
// //  raw = sgp.measureRaw(temp.temperature, humidity.relative_humidity);
// //  Serial.print("VOC: ");
// //  Serial.println(raw);
// //  ThingSpeak.setField(2, raw);
// //  voc_index_G = sgp.measureVocIndex(Temp_VOC, HUM_VOC);
// //  Serial.print("Voc Index: ");
// //  Serial.println(voc_index_G);
// //  delay(1000);
// //}

//------------------------------------------------------Particulate Matter----------------------------------------------------------------------------------------------------------------------

unsigned long previous_loop, previous_10, previous_25, prev_time;

byte command_frame[9] = {0xAA, 0x02, 0x00, 0x00, 0x00, 0x00, 0x01, 0x67, 0xBB};
byte received_data[9];
int sum = 0;
void send_command(byte command)
{
    command_frame[1] = command;
    int sum = command_frame[0] + command_frame[1] + command_frame[2] + command_frame[3] + command_frame[4] + command_frame[5] + command_frame[8];
    int rem = sum % 256;
    command_frame[6] = (sum - rem) / 256;
    command_frame[7] = rem;
    delay(1000);
    Serial.write(command_frame, 9);
}

bool checksum()
{
    sum = int(received_data[0]) + int(received_data[1]) + int(received_data[2]) + int(received_data[3]) + int(received_data[4]) + int(received_data[5]) + int(received_data[8]);
    if (sum == ((int(received_data[6]) * 256) + int(received_data[7])))
    {
        return true;
    }
    else
        return false;
}
void calculate_pm()
{
    pm2 = int(received_data[4]) * 256 + int(received_data[5]);
    delay(2000);
    pm10 = int(received_data[2]) * 256 + int(received_data[3]);
    //   ThingSpeak.setField(3, pm2);//
    // ThingSpeak.setField(4, pm10);
    // Serial.print("PM 2.5 is: ");
    // Serial.println(pm2);
    // Serial.print("PM 10 is: ");
    // Serial.println(pm10);
    //  /
}

void PM_setup()
{
    send_command(0x01);
}

void PM_Reading()
{
    delay(5000);
    if (millis() - prev_time > 5000)
    {
        send_command(0x02);
        prev_time = millis();
    }
    if (Serial.available())
    {
        Serial.readBytes(received_data, 9);
        if (checksum())
        {
            calculate_pm();
        }
    }
}

//--------------------------------------------------------------------------------------------------------------------------------------------------------------------------

void setup()
{
    Serial.begin(115200);
    // pinMode(OLED_SDA, INPUT_PULLUP);           // set pin to input
    // pinMode(OLED_SCL, INPUT_PULLUP);
    // display.begin(SH1106_SWITCHCAPVCC, 0x3C);
    // display.display();
    delay(500);
    // Serial.begin(9600);
    //   delay(5000);
    ConnectToWifi();
    // ThingSpeak.begin(client);
    // SHT_setup();
    // //  SGP_setup();
    PM_setup();
    // display_setup();
}

// int counter = 0;
void loop()
{
    // CO2_Monitor();
    // SHT_Reading();
    // SGP_Reading();
    CreateCIPM2_5();
    CreateCIPM10();
    PM_Reading();
    // display_loop();

    // int prev_time = millis();

    // while ((WiFi.status() != WL_CONNECTED) && ((millis() - prev_time) < 5000))  {
    //   // WiFi.mode(WIFI_STA);
    //   Serial.println("Reconnecting to WiFi...");
    //   WiFi.reconnect();
    // }

    // Display Text
    //  display.clearDisplay();
    /* // display.setTextSize(2); );*/
    // display.setTextColor(WHITE);
    // display.setCursor(0,8);
    // display.println("pm_2.5 =");
    // display.println(pm2);
    // display.display();
    // delay(5000);
    // display.clearDisplay();
    // display.setTextSize(2);
    // display.setTextColor(WHITE);
    // display.setCursor(0,8);
    // display.println("pm_10 =");
    // display.println(pm10);
    // display.display();
    // delay(5000);
    // display.clearDisplay();
    // display.setTextSize(2);
    // display.setTextColor(WHITE);
    // display.setCursor(0,8);
    // display.println("Voc index");
    // display.println(voc_index_G);
    // display.display();
    // delay(5000);
    //  display.clearDisplay();
    // display.setTextSize(3);
    // display.setTextColor(WHITE);
    // display.setCursor(0,8);
    // display.println("temp =");
    // display.println(Temp_VOC);
    // display.display();
    // delay(5000);
    //  display.clearDisplay();
    // display.setTextSize(3);
    // display.setTextColor(WHITE);
    // display.setCursor(0,8);
    // display.println("rH =");
    // display.println(HUM_VOC);
    // display.display();
    // delay(5000);
    //  display.clearDisplay();
    // display.setTextSize(3);
    // display.setTextColor(WHITE);
    // display.setCursor(0,8);
    // display.println("CO2 = ");
    // display.println(ppm);
    // display.display();
    // delay(5000);

    // display.clearDisplay();

    // //  if (WiFi.status() == WL_CONNECTED) {
    // //    Serial.println("Connected ");
    // int x = ThingSpeak.writeFields(myChannelNumber, myWriteAPIKey);
    // if (x == 200) {
    //   Serial.println("Channel update successful.");
    // }
    // else {
    //   Serial.println("Problem updating channel. HTTP error code " + String(x));
    // }

    delay(2000);

    //  Serial.println("---------------------------\n\n");
}
